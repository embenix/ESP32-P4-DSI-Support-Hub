## main/Kconfig.projbuild
```kconfig
menu "Project Configuration"

    config ESP_ERROR_CHECK
        bool "Enable error check in ESP"
        default y
        help
            Error check assert the application before returning the error code.

    menu "HARDWARE"
        choice ESP_HW_TYPE
            prompt "Select Hardware type"
            default ESPRESSIF_ESP32P4_FUNCTION_EV_BOARD
            help
                Select the hardware board you are using.

            config ESPRESSIF_ESP32P4_FUNCTION_EV_BOARD
                bool "ESP32-P4 Function EV Board 1.x.x"
                help
                    Select this option to use the ESP32-P4 Function EV Board.

            config OLIMEX_ESP32P4_DEVKIT
                bool "Olimex ESP32-P4-DevKit"
                help
                    Select this option to use the Olimex ESP32-P4-DevKit board.
                    (https://www.olimex.com/Products/IoT/ESP32-P4/ESP32-P4-DevKit/open-source-hardware)

            config DFROBOT_FIREBEETLE2_ESP32P4
                bool "DFRobot FireBeetle 2 ESP32-P4"
                help
                    Select this option to use the DFRobot FireBeetle 2 ESP32-P4 board.
                    (https://www.dfrobot.com/product-2841.html)

            config WAVESHARE_ESP32P4_MODULE_DEVKIT
                bool "Waveshare ESP32-P4-Module-DEV-KIT"
                help
                    Select this option to use the Waveshare ESP32-P4-Module-DEV-KIT board.
                    (https://www.waveshare.com/esp32-p4-module-dev-kit.htm?sku=30560)

            config GUITION_ESP32P4_DEVKIT
                bool "Guition JC-ESP32P4-M3 DEV Board"
                help
                    Select this option to use the Guition JC-ESP32P4-M3 DEV Board.
                    (https://www.surenoo.com/products/27872758)
        
        endchoice

    endmenu

    menu "I2C"
        config ESP_I2C_NUM
            int "I2C peripheral index"
            default 1
            range 0 1
            help
                ESP32P4 has two I2C peripherals, pick the one you want to use.

        config ESP_I2C_FAST_MODE
            bool "Enable I2C fast mode"
            default y
            help
                I2C has two speed modes: normal (100kHz) and fast (400kHz).
        
        config ESP_I2C_USE_PULLUPS
            bool "Use internal pull-ups for I2C"
            default y
            help
                Use internal pull-ups for I2C SDA and SCL lines.
                External pull-ups are recommended for better signal integrity.

        config ESP_I2C_CLK_SPEED_HZ
            int
            default 400000 if ESP_I2C_FAST_MODE
            default 100000
    endmenu

    menu "Display"
        choice ESP_LCD_TYPE
            prompt "Select LCD type"
            default LUCKFOX_5INCH_DSI_TOUCHSCREEN
            help
                Select the LCD display you are using.

            config LUCKFOX_5INCH_DSI_TOUCHSCREEN
                bool "Luckfox 5inch DSI-DPI LCD Display"
                help 
                    Luckfox's 5inch DSI-DPI LCD Display (800x480) with touch.
                    https://www.luckfox.com/products/5-inch-dsi-dpi-lcd-display-with-touch-for-raspberry-pi

            config DFROBOT_5INCH_DSI_TOUCHSCREEN
                bool "DFRobot 5inch DSI-DPI LCD Display"
                help 
                    DFRobot's 5inch DSI-DPI LCD Display (800x480) with touch.
                    https://www.dfrobot.com/product-2625.html
            
            config RPI_5INCH_TOUCH_DISPLAY_V2
                bool "Raspberry Pi 5inch Touch Display V2"
                help
                    Raspberry Pi 5inch Touch Display V2 (720x1280) with touch.
                    https://www.raspberrypi.com/products/touch-display-2/

            config RPI_7INCH_TOUCH_DISPLAY_V2
                bool "Raspberry Pi 7inch Touch Display V2"
                help
                    Raspberry Pi 7inch Touch Display V2 (720x1280) with touch.
                    https://www.raspberrypi.com/products/touch-display-2/
                    
            config BUYDISPLAY_5INCH_ER_TFT050_10
                bool "BuyDisplay 5inch ER-TFT050-10 720x1280"
                help
                    BuyDisplay 5inch ER-TFT050-10 720x1280 with touch.
                    https://www.buydisplay.com/5-inch-720x1280-ips-tft-lcd-display-mipi-interface-ili9881-controller

            config WAVESHARE_ESP32P4_WIFI6_TOUCH_LCD_3_4C
                bool "Waveshare ESP32-P4-WIFI6-Touch-LCD-3.4C"
                help
                    Waveshare ESP32-P4-WIFI6-Touch-LCD-3.4C with 3.4 inch 800x800 MIPI DSI circular LCD and GT911 touch.
                    https://www.waveshare.com/esp32-p4-wifi6-touch-lcd-3.4c.htm
        
            config RPI_7INCH_TOUCH_DISPLAY_V1
                bool "RPi 7inch Touch Display V1.1 (800x480)"
                help
                    Raspberry Pi 7inch Touch Display V1.1 (800x480) with touch.
                    Earlier version of the Raspberry Pi Touch Display.

            config ELECROW_5INCH_DSI_TOUCHSCREEN
                bool "Elecrow 5inch DSI Touch Display (800x480)"
                help
                    Elecrow 5-inch DSI IPS Display (800x480) with touch.
                    Uses TC358762 bridge and FT5406 touch controller.
                    https://www.elecrow.com/5-inch-dsi-display-ips-800-480-touch-screen-compatible-with-raspberry-pi-4b-3b-3b.html
            
            config AMELIN_EK79007_7INCH_TOUCH_DISPLAY
                bool "Amelin EK79007 7inch Touch Display (experimental)"
                help
                    Amelin EK79007 7inch Touch Display (1024x600) with GT911 touch.
                    Commonly used with the ESP32-P4 Function EV Board.
                    Configure its GPIOs in the Amelin display settings.
                    Product ID: AML070JGI50-07403L
                    https://www.vip-lcd.com/7-Inch-LCD-Touch-Display-Screen-1024-600-LVDS-Interface-with-Touch-Panel-7-0-Inch-Lcd-Module-pd591986658.html
        endchoice                

        menu "Amelin display settings"
            depends on AMELIN_EK79007_7INCH_TOUCH_DISPLAY

            config AMELIN_BACKLIGHT_PWM_GPIO
                int "Backlight PWM GPIO"
                range -1 54
                default 26 if ESPRESSIF_ESP32P4_FUNCTION_EV_BOARD
                default -1
                help
                    GPIO connected to the display backlight PWM input.
                    Defaults to GPIO 26 on the ESP32-P4 Function EV Board.
                    On other boards, choose an available output-capable GPIO.
                    -1 means unconfigured and initialization will fail.
                    Avoid pins used by flash, I2C, or other devices.

            config AMELIN_LCD_RESET_GPIO
                int "LCD reset GPIO"
                range -1 54
                default 27 if ESPRESSIF_ESP32P4_FUNCTION_EV_BOARD
                default -1
                help
                    GPIO connected to the LCD reset input. Defaults to GPIO 27
                    on the ESP32-P4 Function EV Board. Use -1 if reset is not
                    connected to a GPIO. Avoid pins used by other devices.
        endmenu

        # config ESP_LCD_MIPI_DSI_LANE_BITRATE_MBPS
        # int "MIPI DSI lane bitrate (Mbps)"
        # default 1500
        # range 600 1500
        # help
        #     Set the lane bitrate for the MIPI DSI interface in Mbps.
        #     Adjust this value based on the display's requirements and capabilities.
        #     Try 840, 860, 933, 1000, 1200, 1500.

        
    endmenu

    menu "Log - Debugging"
        config PRINT_TOUCH_EVENTS
            bool "Print touch events"
            default n
            help
                Print touch events to the console.
    endmenu
    
endmenu
```
