## boards/sdkconfig.defaults.dfrobot
```kconfig
# Vendor: DFRobot FireBeetle 2 ESP32-P4
# SPI flash configuration (conservative settings for compatibility)
CONFIG_SPI_FLASH_SUPPORT_WINBOND_CHIP=y

# Flash size configuration
# CONFIG_ESPTOOLPY_FLASHSIZE_DETECT=y
CONFIG_ESPTOOLPY_FLASHSIZE_16MB=y
CONFIG_ESPTOOLPY_FLASHSIZE="16MB"

# Flash mode: DIO mode for wider compatibility; switch to QIO only if verified
CONFIG_ESPTOOLPY_FLASHMODE="dio"

# Flash frequency: 40MHz for stability; can be increased to 80MHz if stable
CONFIG_ESPTOOLPY_FLASHFREQ_40M=y
CONFIG_ESPTOOLPY_FLASHFREQ="40m"
# Alternative for better performance (use if tested and stable):
# CONFIG_ESPTOOLPY_FLASHFREQ_80M=y
# CONFIG_ESPTOOLPY_FLASHFREQ="80m"
```

## boards/sdkconfig.defaults.espressif
```kconfig
# Vendor: Espressif Function EV Board
# Sample SPI flash defaults (adjust to your module if needed)

# Prefer auto-detect flash size to work across variants
# CONFIG_ESPTOOLPY_FLASHSIZE_DETECT=y
CONFIG_ESPTOOLPY_FLASHSIZE_16MB=y
CONFIG_ESPTOOLPY_FLASHSIZE="16MB"

# Flash mode: dio is broadly compatible; use qio if confirmed
CONFIG_ESPTOOLPY_FLASHMODE="dio"

# Flash frequency (choose one):
CONFIG_ESPTOOLPY_FLASHFREQ_80M=y
CONFIG_ESPTOOLPY_FLASHFREQ="80m"
# Alternative options
# CONFIG_ESPTOOLPY_FLASHFREQ_40M=y
# CONFIG_ESPTOOLPY_FLASHFREQ="40m"

# Partition table can also be overridden per vendor if needed
# CONFIG_PARTITION_TABLE_CUSTOM=y
# CONFIG_PARTITION_TABLE_FILENAME="partitions.csv"
```

## boards/sdkconfig.defaults.guition
```kconfig
# Vendor: Guition ESP32-P4 Devkit
# Sample SPI flash defaults
CONFIG_SPI_FLASH_SUPPORT_BOYA_CHIP=y

# Auto-detect flash size for flexibility
# CONFIG_ESPTOOLPY_FLASHSIZE_DETECT=y
CONFIG_ESPTOOLPY_FLASHSIZE_16MB=y
CONFIG_ESPTOOLPY_FLASHSIZE="16MB"

# Mode: start with dio unless QIO is confirmed on this module
CONFIG_ESPTOOLPY_FLASHMODE="dio"

# Frequency: start at 40MHz; increase to 80MHz if verified stable
CONFIG_ESPTOOLPY_FLASHFREQ_40M=y
CONFIG_ESPTOOLPY_FLASHFREQ="40m"
# Alternative
# CONFIG_ESPTOOLPY_FLASHFREQ_80M=y
# CONFIG_ESPTOOLPY_FLASHFREQ="80m"
```

## boards/sdkconfig.defaults.olimex
```kconfig
# Vendor: Olimex ESP32-P4 Devkit
# Sample SPI flash defaults (conservative)
CONFIG_SPI_FLASH_SUPPORT_WINBOND_CHIP=y

# Prefer auto-detect for size across variants
# CONFIG_ESPTOOLPY_FLASHSIZE_DETECT=y
CONFIG_ESPTOOLPY_FLASHSIZE_16MB=y
CONFIG_ESPTOOLPY_FLASHSIZE="16MB"

# Flash mode: some modules default to DIO; switch to QIO only if verified
CONFIG_ESPTOOLPY_FLASHMODE="dio"

# Frequency: use 40MHz for wider compatibility; bump to 80MHz if stable
CONFIG_ESPTOOLPY_FLASHFREQ_40M=y
CONFIG_ESPTOOLPY_FLASHFREQ="40m"
# Alternative
# CONFIG_ESPTOOLPY_FLASHFREQ_80M=y
# CONFIG_ESPTOOLPY_FLASHFREQ="80m"
```

## boards/sdkconfig.defaults.waveshare
```kconfig
# Vendor: Waveshare ESP32-P4 Module Devkit
# Sample SPI flash defaults

# Prefer auto-detect size
# CONFIG_ESPTOOLPY_FLASHSIZE_DETECT=y
CONFIG_ESPTOOLPY_FLASHSIZE_16MB=y
CONFIG_ESPTOOLPY_FLASHSIZE="16MB"

# Mode: dio for broad compatibility
CONFIG_ESPTOOLPY_FLASHMODE="dio"

# Frequency: many Waveshare modules are fine at 80MHz; adjust if needed
CONFIG_ESPTOOLPY_FLASHFREQ_80M=y
CONFIG_ESPTOOLPY_FLASHFREQ="80m"
# Alternative
# CONFIG_ESPTOOLPY_FLASHFREQ_40M=y
# CONFIG_ESPTOOLPY_FLASHFREQ="40m"
```

## components/esp_lvgl_port/Kconfig
```kconfig
menu "ESP LVGL PORT"

    config LVGL_PORT_ENABLE_PPA
        depends on SOC_PPA_SUPPORTED
        bool "Enable PPA for screen rotation"
        default n
        help
            Enables using PPA for screen rotation.

    config ESP_LVGL_PORT_TASK_STACK_SIZE
        int "LVGL Port task stack size (bytes)"
        default 16384
        help
            Stack size for the LVGL port task that handles LVGL timers and rendering.
            Increase this if you see stack overflow errors during widget initialization
            or when using complex UI elements. Default is 16KB (increased from 7KB to
            handle printf/logging during demo initialization).

endmenu
```

## main/Kconfig
```kconfig
menu "Board Support Package(ESP32-P4)"

    config ESP_ERROR_CHECK
        bool "Enable error check in ESP"
        default y
        help
            Error check assert the application before returning the error code.

    menu "HARDWARE"
        config ESPRESSIF_ESP32P4_FUNCTION_EV_BOARD
            bool "ESP32-P4 Function EV Board 1.x.x"
            default y
            help
                Select this option to use the ESP32-P4 Function EV Board.

        config OLIMEX_ESP32P4_DEVKIT
            bool "Olimex ESP32-P4-DevKit"
            help
                Select this option to use the Olimex ESP32-P4-DevKit board.
                (https://www.olimex.com/Products/IoT/ESP32-P4/ESP32-P4-DevKit/open-source-hardware)

        config WAVESHARE_ESP32P4_MODULE_DEVKIT
            bool "Waveshare ESP32-P4-Module-DEV-KIT"
            help
                Select this option to use the Waveshare ESP32-P4-Module-DEV-KIT board.
                (https://www.waveshare.com/esp32-p4-module-dev-kit.htm?sku=30560)

        config GUITION_ESP32P4_DEVKIT
            bool "Guition JC-ESP32P4-M3 DEV Board"
            help
                Select this option to use the Guition JC-ESP32P4-M3 DEV Board.
                (https://www.surenoo.com/products/27872758)

    endmenu

    menu "I2C"
        config ESP_I2C_NUM
            int "I2C peripheral index"
            default 1
            range 0 1
            help
                ESP32P4 has two I2C peripherals, pick the one you want to use.

        config ESP_I2C_FAST_MODE
            bool "Enable I2C fast mode"
            default y
            help
                I2C has two speed modes: normal (100kHz) and fast (400kHz).

        config ESP_I2C_CLK_SPEED_HZ
            int
            default 400000 if ESP_I2C_FAST_MODE
            default 100000
    endmenu

    menu "I2S"
        config ESP_I2S_NUM
            int "I2S peripheral index"
            default 1
            range 0 2
            help
                ESP32P4 has three I2S peripherals, pick the one you want to use.
    endmenu

    menu "uSD card - Virtual File System"
        config ESP_SD_FORMAT_ON_MOUNT_FAIL
            bool "Format uSD card if mounting fails"
            default n
            help
                The SDMMC host will format (FAT) the uSD card if it fails to mount the filesystem.

        config ESP_SD_MOUNT_POINT
            string "uSD card mount point"
            default "/sdcard"
            help
                Mount point of the uSD card in the Virtual File System

    endmenu

    menu "SPIFFS - Virtual File System"
        config ESP_SPIFFS_FORMAT_ON_MOUNT_FAIL
            bool "Format SPIFFS if mounting fails"
            default n
            help
                Format SPIFFS if it fails to mount the filesystem.

        config ESP_SPIFFS_MOUNT_POINT
            string "SPIFFS mount point"
            default "/spiffs"
            help
                Mount point of SPIFFS in the Virtual File System.

        config ESP_SPIFFS_PARTITION_LABEL
            string "Partition label of SPIFFS"
            default "storage"
            help
                Partition label which stores SPIFFS.

        config ESP_SPIFFS_MAX_FILES
            int "Max files supported for SPIFFS VFS"
            default 5
            help
                Supported max files for SPIFFS in the Virtual File System.
    endmenu

    menu "Display"
        config ESP_LCD_DPI_BUFFER_NUMS
            int "Set number of frame buffers"
            default 1
            range 1 3
            help
                Let DPI LCD driver create a specified number of frame-size buffers. Only when it is set to multiple can the avoiding tearing be turned on.

        config ESP_DISPLAY_LVGL_AVOID_TEAR
            bool "Avoid tearing effect"
            depends on ESP_LCD_DPI_BUFFER_NUMS > 1
            default "n"
            help
                Avoid tearing effect through LVGL buffer mode and double frame buffers of RGB LCD. This feature is only available for RGB LCD.

        choice ESP_DISPLAY_LVGL_MODE
            depends on ESP_DISPLAY_LVGL_AVOID_TEAR
            prompt "Select LVGL buffer mode"
            default ESP_DISPLAY_LVGL_FULL_REFRESH
            config ESP_DISPLAY_LVGL_FULL_REFRESH
                bool "Full refresh"
            config ESP_DISPLAY_LVGL_DIRECT_MODE
                bool "Direct mode"
        endchoice
            
        config ESP_DISPLAY_BRIGHTNESS_LEDC_CH
        int "LEDC channel index"
        default 1
        range 0 7
        help
            LEDC channel is used to generate PWM signal that controls display brightness.
            Set LEDC index that should be used.

        choice ESP_LCD_COLOR_FORMAT
            prompt "Select LCD color format"
            default ESP_LCD_COLOR_FORMAT_RGB565
            help
                Select the LCD color format RGB565/RGB888.

            config ESP_LCD_COLOR_FORMAT_RGB565
                bool "RGB565"
            config ESP_LCD_COLOR_FORMAT_RGB888
                bool "RGB888"
        endchoice   
            
        choice ESP_LCD_TYPE
            prompt "Select LCD type"
            default LUCKFOX_5INCH_DSI_TOUCHSCREEN
            help
                Select the LCD.

            # config ESP_LCD_TYPE_800_1280_10_1_INCH
            #     bool "Waveshare 101M-8001280-IPS-CT-K Display"
            # config ESP_LCD_TYPE_800_1280_10_1_INCH_A
            #     bool "Waveshare 10.1-DSI-TOUCH-A Display"
            # config ESP_LCD_TYPE_800_1280_8_INCH_A
            #     bool "Waveshare 8-DSI-TOUCH-A Display"
            # config ESP_LCD_TYPE_720_1280_7_INCH_A
            #     bool "Waveshare 7-DSI-TOUCH-A Display"
            # config ESP_LCD_TYPE_720_1280_5_INCH_A
            #     bool "Waveshare 5-DSI-TOUCH-A Display"
            # config ESP_LCD_TYPE_480_640_2_8_INCH
            #     bool "Waveshare 2.8inch DSI LCD Display"
            # config ESP_LCD_TYPE_800_800_3_4_INCH_C
            #     bool "Waveshare 3.4inch DSI LCD (C) Display"
            # config ESP_LCD_TYPE_720_720_4_INCH_C
            #     bool "Waveshare 4inch DSI LCD (C) Display"
            # config ESP_LCD_TYPE_480_800_4_INCH
            #     bool "Waveshare 4inch DSI LCD Display"
            # config ESP_LCD_TYPE_720_1280_5_INCH_D
            #     bool "Waveshare 5inch DSI LCD (D) Display"
            # config ESP_LCD_TYPE_720_1560_6_25_INCH
            #     bool "Waveshare 6.25inch DSI LCD Display"
            # config ESP_LCD_TYPE_1024_600_5_INCH_C
            #     bool "Waveshare 5inch DSI LCD (C) Display"
            # config ESP_LCD_TYPE_1024_600_7_INCH_C
            #     bool "Waveshare 7inch DSI LCD (C) Display"
            # config ESP_LCD_TYPE_400_1280_7_9_INCH
            #     bool "Waveshare 7.9inch DSI LCD Display"
            # config ESP_LCD_TYPE_1280_800_7_INCH_E
            #     bool "Waveshare 7inch DSI LCD (E) Display"
            # config ESP_LCD_TYPE_1280_800_8_INCH_C
            #     bool "Waveshare 8inch DSI LCD (C) Display"
            # config ESP_LCD_TYPE_1280_800_10_1_INCH_C
            #     bool "Waveshare 10.1inch DSI LCD (C) Display"
            # config ESP_LCD_TYPE_480_1920_8_8_INCH
            #     bool "Waveshare 8.8inch DSI LCD Display"
            # config ESP_LCD_TYPE_320_1480_11_9_INCH
            #     bool "Waveshare 11.9inch DSI LCD Display"
            config LUCKFOX_5INCH_DSI_TOUCHSCREEN
                bool "Luckfox's 5inch DSI-DPI LCD Display"
            config DFROBOT_5INCH_DSI_TOUCHSCREEN
                bool "DFRobot's 5inch DSI-DPI LCD Display"
        endchoice

        config ESP_LCD_MIPI_DSI_LANE_BITRATE_MBPS
        int "MIPI DSI lane bitrate (Mbps)"
        default 1500
        range 600 1500
        help
            Set the lane bitrate for the MIPI DSI interface in Mbps.
            Adjust this value based on the display's requirements and capabilities.
            Try 840, 860, 933, 1000, 1200, 1500.

        
    endmenu
    
endmenu
```
